## config/boards/shields/BEST_BOARD_EVER/Kconfig.defconfig
```kconfig
# Copyright (c) 2020 The ZMK Contributors
# SPDX-License-Identifier: MIT

if SHIELD_BEST_BOARD_EVER
config ZMK_KEYBOARD_NAME
	default "BEST_BOARD_EVER"
config ZMK_SLEEP
  default y
config ZMK_IDLE_SLEEP_TIMEOUT
  default 600000
endif
```

## config/boards/shields/BEST_BOARD_EVER/Kconfig.shield
```kconfig
# Copyright (c) 2020 The ZMK Contributors
# SPDX-License-Identifier: MIT

config SHIELD_BEST_BOARD_EVER
	def_bool $(shields_list_contains,BEST_BOARD_EVER)
```

## config/boards/shields/num_b4r_18/Kconfig.defconfig
```kconfig
# Copyright (c) 2020 The ZMK Contributors
# SPDX-License-Identifier: MIT

if SHIELD_NUM_B4R_18

config ZMK_KEYBOARD_NAME
	default "NUM_B4R_18"
config ZMK_SLEEP
  default y
config ZMK_IDLE_SLEEP_TIMEOUT
  default 600000
endif
```

## config/boards/shields/num_b4r_18/Kconfig.shield
```kconfig
# Copyright (c) 2020 The ZMK Contributors
# SPDX-License-Identifier: MIT

config SHIELD_NUM_B4R_18
	def_bool $(shields_list_contains,num_b4r_18)
```
